#include <esp_now.h>
#include <esp_wifi.h>
#include <WiFi.h>

// Logging statement for debuging over serial monitor, disable for final flashing
#define SHOW_SUCCESS 0

// =======================
// ESP-NOW CONFIG (Template generated by ChatGPT based on writen power management sensor code)
// =======================

// This is a specific receiver MAC, update if the receiver module is changed
uint8_t receiverAddr[] = { 0xac, 0xeb, 0xe6, 0x49, 0xc7, 0xcc };

esp_now_peer_info_t peerInfo;

// =======================
// COMMON PACKET TEMPLATE
// =======================

uint32_t str_to_u32(const char s[4]) {
  return ((uint32_t)s[3] << 24) |
         ((uint32_t)s[2] << 16) |
         ((uint32_t)s[1] << 8)  |
         ((uint32_t)s[0]);
}

// Fast byte checksum.
// Computes over everything except the checksum field itself.
uint16_t checksum16_bytes(const uint8_t *data, size_t len) {
  uint16_t sum = 0;
  for (size_t i = 0; i < len; i++) {
    sum = (uint16_t)((sum << 1) ^ data[i] ^ (sum >> 15));
  }

  return sum;
}

// PayloadT is application-specific.
// PAD_BYTES is explicit padding, usually 0 unless you want fixed-size packets.
template <typename PayloadT, size_t PAD_BYTES = 0>
// Ensure total bytes is 28 (After padding it). Must be adjusted for both sender and data parsing code
struct __attribute__((packed)) PacketTemplate {
  uint32_t header;
  uint16_t counter;
  PayloadT payload;
  uint8_t padding[PAD_BYTES];
  uint16_t chksum;
};

template <typename PacketT>
void clearPacket(PacketT &pkt) {
  memset(&pkt, 0, sizeof(pkt));
}

template <typename PacketT>
void finalizePacket(PacketT &pkt, uint32_t header, uint16_t counter) {
  pkt.header = header;
  pkt.counter = counter;

  // Padding should be zero because clearPacket() was called before filling.
  pkt.chksum = checksum16_bytes(
    (const uint8_t *)&pkt,
    sizeof(pkt) - sizeof(pkt.chksum)
  );
}

template <typename PacketT>
bool sendPacket(const PacketT &pkt) {
  esp_err_t result = esp_now_send(receiverAddr, (const uint8_t *)&pkt, sizeof(pkt));

  if (result != ESP_OK) {
    taskYIELD();
    result = esp_now_send(receiverAddr, (const uint8_t *)&pkt, sizeof(pkt));
  }

  if (result != ESP_OK) {
    Serial.println("Failed to queue");
    return false;
  }

#if SHOW_SUCCESS
  Serial.println("Successfully queued for sending");
#endif

  return true;
}

template <typename PacketT, size_t COUNT>
bool sendPacketArray(const PacketT (&packets)[COUNT]) {
  esp_err_t result = esp_now_send(receiverAddr, (const uint8_t *)packets, sizeof(packets));

  if (result != ESP_OK) {
    taskYIELD();
    result = esp_now_send(receiverAddr, (const uint8_t *)packets, sizeof(packets));
  }

  if (result != ESP_OK) {
    Serial.println("Failed to queue");
    return false;
  }

#if SHOW_SUCCESS
  Serial.println("Successfully queued for sending");
#endif

  return true;
}

// =======================
// ESP-NOW SETUP
// =======================

void onESPNowSent(const uint8_t *mac_addr, esp_now_send_status_t status) {
#if SHOW_SUCCESS
  if (status == ESP_NOW_SEND_SUCCESS) {
    Serial.println("Delivery Success");
  }
#endif

  if (status != ESP_NOW_SEND_SUCCESS) {
    Serial.println("Delivery Fail");
  }
}

bool init_ESP_NOW() {
  if (esp_now_init() != ESP_OK) {
    Serial.println("ESP-NOW failed to initialise");
    return false;
  }

  esp_now_register_send_cb(onESPNowSent);

  memset(&peerInfo, 0, sizeof(peerInfo));

  memcpy(peerInfo.peer_addr, receiverAddr, 6);

  peerInfo.channel = 0;
  peerInfo.encrypt = false;

  if (esp_now_add_peer(&peerInfo) != ESP_OK) {
    Serial.println("Failed to add receiving device");
    return false;
  }

  return true;
}

// =======================
// APPLICATION EXAMPLES
// =======================

// Example 1: high-speed power sensor payload.
// This replaces the application-specific part of your old Packet.
struct __attribute__((packed)) PowerPayload {
  uint32_t timediff_us;
  uint16_t readings[8];
};

// No padding for power sensor because it is high-speed.
using PowerPacket = PacketTemplate<PowerPayload, 0>;

#define POWER_PACKET_COUNT 6

PowerPacket powerPackets[POWER_PACKET_COUNT];

uint32_t POWER_HEADER;
uint16_t powerCounter = 1;
uint16_t powerPacketPosition = 0;
uint32_t prevTime_us = 0;

// Example 2: slow sensor payload.
struct __attribute__((packed)) SlowPayload {
  uint32_t timestamp_ms;
  uint16_t value1;
  uint16_t value2;
};

// Example with 8 bytes of explicit padding before checksum.
using SlowPacket = PacketTemplate<SlowPayload, 8>;

uint32_t SLOW_HEADER;
uint16_t slowCounter = 1;

// =======================
// APPLICATION FILL FUNCTIONS
// =======================

void incrementCounter(uint16_t &counter) {
  if (counter == 65535) {
    counter = 1;
  } else {
    counter++;
  }
}

// Replace this with your real ADC read function.
void fillPowerPayload(PowerPayload &payload) {
  uint32_t now_us = micros();

  payload.timediff_us = now_us - prevTime_us;
  prevTime_us = now_us;

  for (int i = 0; i < 8; i++) {
    payload.readings[i] = 0;  // Fill with real sensor data.
  }
}

// Replace this with your real slow sensor read function.
void fillSlowPayload(SlowPayload &payload) {
  payload.timestamp_ms = millis();
  payload.value1 = 123;
  payload.value2 = 456;
}

// =======================
// SETUP / LOOP
// =======================

void setup() {
  Serial.begin(2000000);

  WiFi.mode(WIFI_STA);

  while (!init_ESP_NOW()) {
    delay(100);
  }

  char powerRole[4] = { 'P', 'W', 'E', 'R' };
  char slowRole[4]  = { 'S', 'L', 'O', 'W' };

  POWER_HEADER = str_to_u32(powerRole);
  SLOW_HEADER = str_to_u32(slowRole);

  prevTime_us = micros();

  Serial.println("Finished setup");
}

void loop() {
  // =======================
  // HIGH-SPEED POWER SENSOR
  // =======================

  while (powerPacketPosition < POWER_PACKET_COUNT) {
    PowerPacket &pkt = powerPackets[powerPacketPosition];

    clearPacket(pkt);

    fillPowerPayload(pkt.payload);

    finalizePacket(pkt, POWER_HEADER, powerCounter);

    incrementCounter(powerCounter);
    powerPacketPosition++;
  }

  sendPacketArray(powerPackets);

  powerPacketPosition = 0;

  // =======================
  // SLOW SENSOR EXAMPLE
  // =======================
  // In a real app, only run this once per second using millis() timing.

  /*
  static uint32_t lastSlowSend_ms = 0;

  if (millis() - lastSlowSend_ms >= 1000) {
    lastSlowSend_ms = millis();

    SlowPacket pkt;
    clearPacket(pkt);

    fillSlowPayload(pkt.payload);

    finalizePacket(pkt, SLOW_HEADER, slowCounter);

    incrementCounter(slowCounter);

    sendPacket(pkt);
  }
  */

  taskYIELD();
}