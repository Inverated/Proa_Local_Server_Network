#include <esp_now.h>
#include <esp_wifi.h>
#include <WiFi.h>
#include <Wire.h>
#include <Adafruit_INA219.h>
#include <U8g2lib.h>
#include <MUIU8g2.h>

// Logging statement for debuging over serial monitor, disable for final flashing
#define SHOW_SUCCESS 0

// =======================
// ESP-NOW CONFIG (Template generated by ChatGPT based on writen power management sensor code)
// =======================

// This is a specific receiver MAC, update if the receiver module is changed
uint8_t receiverAddr[] = { 0xac, 0xeb, 0xe6, 0x49, 0xc7, 0xcc };

esp_now_peer_info_t peerInfo;

// =======================
// COMMON PACKET TEMPLATE
// =======================

uint32_t str_to_u32(const char s[4]) {
  return ((uint32_t)s[3] << 24) | ((uint32_t)s[2] << 16) | ((uint32_t)s[1] << 8) | ((uint32_t)s[0]);
}

// Fast byte checksum.
// Computes over everything except the checksum field itself.
uint16_t checksum16_bytes(const uint8_t *data, size_t len) {
  uint16_t sum = 0;
  for (size_t i = 0; i < len; i++) {
    sum = (uint16_t)((sum << 1) ^ data[i] ^ (sum >> 15));
  }

  return sum;
}

// PayloadT is application-specific.
// PAD_BYTES is explicit padding, usually 0 unless you want fixed-size packets.
template<typename PayloadT, size_t PAD_BYTES = 0>
// Ensure total bytes is 28 (After padding it). Must be adjusted for both sender and data parsing code
// Remaining payload size = 28 - 4 - 2 - 2 = 20 bytes
struct __attribute__((packed)) PacketTemplate {
  uint32_t header;
  uint16_t counter;
  PayloadT payload;
  uint8_t padding[PAD_BYTES];
  uint16_t chksum;
};

template<typename PacketT>
void clearPacket(PacketT &pkt) {
  memset(&pkt, 0, sizeof(pkt));
}

template<typename PacketT>
void finalizePacket(PacketT &pkt, uint32_t header, uint16_t counter) {
  pkt.header = header;
  pkt.counter = counter;

  // Padding should be zero because clearPacket() was called before filling.
  pkt.chksum = checksum16_bytes(
    (const uint8_t *)&pkt,
    sizeof(pkt) - sizeof(pkt.chksum));
}

template<typename PacketT>
bool sendPacket(const PacketT &pkt) {
  esp_err_t result = esp_now_send(receiverAddr, (const uint8_t *)&pkt, sizeof(pkt));

  if (result != ESP_OK) {
    taskYIELD();
    result = esp_now_send(receiverAddr, (const uint8_t *)&pkt, sizeof(pkt));
  }

  if (result != ESP_OK) {
    Serial.println("Failed to queue");
    return false;
  }

#if SHOW_SUCCESS
  Serial.println("Successfully queued for sending");
#endif

  return true;
}

template<typename PacketT, size_t COUNT>
bool sendPacketArray(const PacketT (&packets)[COUNT]) {
  esp_err_t result = esp_now_send(receiverAddr, (const uint8_t *)packets, sizeof(packets));

  if (result != ESP_OK) {
    taskYIELD();
    result = esp_now_send(receiverAddr, (const uint8_t *)packets, sizeof(packets));
  }

  if (result != ESP_OK) {
    Serial.println("Failed to queue");
    return false;
  }

#if SHOW_SUCCESS
  Serial.println("Successfully queued for sending");
#endif

  return true;
}

// =======================
// ESP-NOW SETUP
// =======================

void onESPNowSent(const esp_now_send_info_t *info, esp_now_send_status_t status) {
#if SHOW_SUCCESS
  if (status == ESP_NOW_SEND_SUCCESS) {
    Serial.println("Delivery Success");
  }
#endif

  if (status != ESP_NOW_SEND_SUCCESS) {
    Serial.println("Delivery Fail");
  }
}

bool init_ESP_NOW() {
  if (esp_now_init() != ESP_OK) {
    Serial.println("ESP-NOW failed to initialise");
    return false;
  }

  esp_now_register_send_cb(onESPNowSent);

  memset(&peerInfo, 0, sizeof(peerInfo));

  memcpy(peerInfo.peer_addr, receiverAddr, 6);

  peerInfo.channel = 0;
  peerInfo.encrypt = false;

  if (esp_now_add_peer(&peerInfo) != ESP_OK) {
    Serial.println("Failed to add receiving device");
    return false;
  }

  return true;
}

// =======================
// APPLICATION
// =======================

Adafruit_INA219 ina219;
#define SDA_PIN 0
#define SCL_PIN 1

U8G2_SSD1306_72X40_ER_F_SW_I2C u8g2(U8G2_R0, /* clock=*/6, /* data=*/5, /* reset=*/U8X8_PIN_NONE);

float shuntvoltage = 0;
float busvoltage = 0;
float current_mA = 0;
float loadvoltage = 0;
float power_mW = 0;

bool init_OLED() {

  // finish later
  u8g2.begin();
  u8g2.setFont(u8g2_font_ncenB08_tr);
  u8g2.setDrawColor(1);  // White
  u8g2.clearBuffer();
  u8g2.drawStr(0, 10, "Hallo");
  u8g2.drawStr(0, 22, "wold");
  u8g2.sendBuffer();
  return true;
}

struct __attribute__((packed)) Sensor_Power_Payload {
  float shuntvoltage;  // float equivalent to 32bit
  float busvoltage;
  float current_mA;
  float loadvoltage;
  float power_mW;
};


using Sensor_Power_Packet = PacketTemplate<Sensor_Power_Payload, 0>;

uint32_t SENSOR_PWR_HEADER;
uint16_t counter = 1;

void incrementCounter(uint16_t &counter) {
  if (counter == 65535) {
    counter = 1;
  } else {
    counter++;
  }
}

Sensor_Power_Payload getSensorPowerPayload() {
  Sensor_Power_Payload payload;
  payload.shuntvoltage = ina219.getShuntVoltage_mV();
  payload.busvoltage = ina219.getBusVoltage_V();
  payload.current_mA = ina219.getCurrent_mA();
  payload.power_mW = ina219.getPower_mW();
  payload.loadvoltage = payload.busvoltage + (payload.shuntvoltage / 1000);
  return payload;
}
// Manual prototype after the struct
// Stops caching causing failed to find Sensor_Power_Payload type
Sensor_Power_Payload getSensorPowerPayload();

void updateDisplay(float busvoltage, float current_mA, float power_mW) {
  u8g2.clearBuffer();
  String v_message = "V:" + String(busvoltage, 2) + "V";
  u8g2.drawStr(0, 10, v_message.c_str());
  String A_message = "I:" + String(current_mA, 2) + "mA";
  u8g2.drawStr(0, 22, A_message.c_str());
  String P_message = "P:" + String(power_mW, 0) + "mW";
  u8g2.drawStr(0, 34, P_message.c_str());
  u8g2.sendBuffer();
}

// =======================
// SETUP / LOOP
// =======================
uint32_t prev_time;

void setup() {
  Serial.begin(2000000);

  WiFi.mode(WIFI_STA);

  while (!init_ESP_NOW()) {
    delay(100);
  }

  init_OLED();
  Wire.begin(SDA_PIN, SCL_PIN);

  while (!ina219.begin()) {
    Serial.println("Failed to find");
    delay(1000);
  }

  ina219.setCalibration_32V_2A();

  char role[4] = { 'S', 'E', 'N', 'S' };

  SENSOR_PWR_HEADER = str_to_u32(role);

  prev_time = millis();

  Serial.println("Finished setup");
}

void loop() {
  // =======================
  // HIGH-SPEED POWER SENSOR
  // =======================

  uint32_t time_now = millis();

  if (time_now - prev_time >= 1000) {
    Sensor_Power_Packet pkt;
    clearPacket(pkt);

    pkt.payload = getSensorPowerPayload();
    updateDisplay(pkt.payload.busvoltage, pkt.payload.current_mA, pkt.payload.power_mW);

    finalizePacket(pkt, SENSOR_PWR_HEADER, counter);

    incrementCounter(counter);

    sendPacket(pkt);
  }

  taskYIELD();
}